#define CONFIG_WIRELESS 1
#define ZMK_BASE_LAYER(name, LT, RT, LM, RM, LB, RB, LH, RH)   \
    ZMK_LAYER(                                                 \
        name,                                                  \
                LT RT                                          \
                LM RM                                          \
                LB RB                                          \
                LH RH                                          \
    )
#define HOST_OS 1
#include "zmk-helpers/key-labels/42.h"
#include "base.keymap"

/ { 
    chosen { 
        zmk,physical-layout = &foostan_corne_6col_layout;
        };
};